## Code/MCU/Layer_View_SDK/mcuxsdk/examples/ese_projects/kidbytes_view/Kconfig
```kconfig
mainmenu "kidbytes_view"

source "${SdkRootDirPath}/Kconfig.mcuxpresso"

osource "${SdkRootDirPath}/${project_board_port_path}/Kconfig"
```
